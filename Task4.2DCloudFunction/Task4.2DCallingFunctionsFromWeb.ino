/*
  CloudAndLocalHTTP_Fixed.ino
  - Local HTTP server on port 8080:
      GET  /ping
      POST /command  { "room":"living room", "action":"on", "timer":30 }
  - Integrates with Arduino IoT Cloud via thingProperties.h (cloudCommand String variable)
  - Simple, tolerant JSON helpers for the small payloads used here
  - Pin mapping: living room -> PIN_LIVING, bathroom -> PIN_BATH, closet -> PIN_CLOSET
*/

#include <ArduinoIoTCloud.h>
#include <Arduino_ConnectionHandler.h>
#include <WiFiNINA.h>
#include "thingProperties.h"   // generated by Cloud Editor (must exist)

// Pin definitions
#define PIN_LIVING 6
#define PIN_BATH   3
#define PIN_CLOSET 4

// Local HTTP server (used by the web UI / Node-RED)
WiFiServer server(8080);


// Timer state (non-blocking)
unsigned long timerEndMillis = 0; // when the timer should expire
int timerTargetPin = -1;          // which pin the timer will affect
bool timerActive = false;         // whether a timer is currently active


// Local state to avoid re-processing the same cloud command repeatedly
String lastCloudCommand = "";

// Prototypes
void handleCloudCommand(const String &cmd);
void toggleRoom(const String &room, const String &action, int timerSeconds);
int roomToPin(const String &room);
String extractJsonString(const String &body, const String &key);
int extractJsonInt(const String &body, const String &key);
void handleLocalHttp();
void setupPins();


// Setup helper: configure pins and initial states
void setupPins() {
  pinMode(PIN_LIVING, OUTPUT);
  pinMode(PIN_BATH, OUTPUT);
  pinMode(PIN_CLOSET, OUTPUT);

  // Initialize outputs to OFF (LOW). If you wire any LED active-low,
  // change this initialization accordingly.
  digitalWrite(PIN_LIVING, LOW);
  digitalWrite(PIN_BATH, LOW);
  digitalWrite(PIN_CLOSET, LOW);
}

// Required cloud callback (empty)
// The Cloud library expects this symbol; we handle cloudCommand changes in loop()
void onCloudCommandChange() {
  // Intentionally empty
}

// Arduino setup()
// - Serial for debugging
// - initialize pins
// - initialize cloud properties and connection
// - start local HTTP server
void setup() {
  Serial.begin(115200);
  while (!Serial && millis() < 3000); // wait briefly for Serial (if available)

  setupPins();

  // Initialize cloud properties (thingProperties.h must define initProperties and cloudCommand)
  initProperties();

  // Start Cloud connection (uses ArduinoIoTPreferredConnection from thingProperties.h)
  ArduinoCloud.begin(ArduinoIoTPreferredConnection);
  setDebugMessageLevel(1);
  ArduinoCloud.printDebugInfo();

  // Print WiFi status and IP for debugging
  Serial.print("WiFi status: ");
  Serial.println(WiFi.status());
  Serial.print("Local IP: ");
  Serial.println(WiFi.localIP());

  // Start local HTTP server for direct POST /command and simple GET endpoints
  server.begin();
  Serial.println("Local HTTP server started on port 8080");
}

// Main loop()
// - keep cloud connection alive
// - process cloudCommand changes (only when it differs from lastCloudCommand)
// - check non-blocking timer expiry
// - handle incoming local HTTP requests
void loop() {
  // Keep cloud connection alive and process any cloud callbacks
  ArduinoCloud.update();

  // If cloudCommand changed and is non-empty, handle it once
  if (cloudCommand != lastCloudCommand && cloudCommand.length() > 0) {
    Serial.print("New cloudCommand: ");
    Serial.println(cloudCommand);
    handleCloudCommand(cloudCommand);
    lastCloudCommand = cloudCommand;
  }

  // Timer expiry: non-blocking check so loop() remains responsive
  if (timerActive && timerTargetPin >= 0 && millis() >= timerEndMillis) {
    // Turn the pin OFF when the timer expires
    digitalWrite(timerTargetPin, LOW);
    Serial.print("Timer expired: turned pin ");
    Serial.print(timerTargetPin);
    Serial.println(" OFF");
    timerActive = false;
    timerTargetPin = -1;
  }

  // Serve any incoming local HTTP requests
  handleLocalHttp();
}

// Parse a cloudCommand string and dispatch
// Format supported:
//   "room"                -> toggle
//   "room:action"         -> action (on/off/toggle)
//   "room:action:seconds" -> action with timer
void handleCloudCommand(const String &cmd) {
  String s = cmd;
  int firstColon = s.indexOf(':');
  int secondColon = s.indexOf(':', firstColon + 1);

  String room, action;
  int timerSeconds = 0;

  if (firstColon == -1) {
    // No colon -> treat as toggle
    room = s;
    action = "toggle";
  } else {
    room = s.substring(0, firstColon);
    if (secondColon == -1) {
      // single colon -> room:action
      action = s.substring(firstColon + 1);
    } else {
      // two colons -> room:action:timer
      action = s.substring(firstColon + 1, secondColon);
      String t = s.substring(secondColon + 1);
      timerSeconds = t.toInt();
    }
  }

  room.trim();
  action.trim();
  toggleRoom(room, action, timerSeconds);
}

// Map room name (string) to a pin number
// Accepts a few common aliases for convenience
int roomToPin(const String &room) {
  String r = room;
  r.toLowerCase();
  r.trim();
  if (r == "living room" || r == "living" || r == "livingroom") return PIN_LIVING;
  if (r == "bathroom" || r == "bath") return PIN_BATH;
  if (r == "closet") return PIN_CLOSET;
  return -1;
}

// Perform the requested action for a room
// - action: "on", "off", "toggle"
// - timerSeconds: optional non-blocking auto-off (only applied when action == "on")
void toggleRoom(const String &room, const String &action, int timerSeconds) {
  int pin = roomToPin(room);
  if (pin < 0) {
    Serial.print("Unknown room: ");
    Serial.println(room);
    return;
  }

  if (action.equalsIgnoreCase("on")) {
    digitalWrite(pin, HIGH);
    Serial.print("Set pin ");
    Serial.print(pin);
    Serial.println(" HIGH");
  } else if (action.equalsIgnoreCase("off")) {
    digitalWrite(pin, LOW);
    Serial.print("Set pin ");
    Serial.print(pin);
    Serial.println(" LOW");
  } else if (action.equalsIgnoreCase("toggle")) {
    // Read the current output state and invert it
    int current = digitalRead(pin);
    digitalWrite(pin, !current);
    Serial.print("Toggled pin ");
    Serial.print(pin);
    Serial.print(" to ");
    Serial.println(!current);
  } else {
    Serial.print("Unknown action: ");
    Serial.println(action);
    return;
  }

  // If a timer was requested (and the action was "on"), schedule a non-blocking timer
  if (timerSeconds > 0 && action.equalsIgnoreCase("on")) {
    timerTargetPin = pin;
    timerEndMillis = millis() + (unsigned long)timerSeconds * 1000UL;
    timerActive = true;
    Serial.print("Timer set for pin ");
    Serial.print(pin);
    Serial.print(" for ");
    Serial.print(timerSeconds);
    Serial.println(" seconds");
  }
}

// Local HTTP handling
// - Supports:
//     GET  /ping
//     GET  /toggle?pin=<n>&state=<0|1>   (manual testing)
//     POST /command  { "room":"...", "action":"on", "timer":30 }
// - The request parsing is intentionally simple and tolerant for small payloads
void handleLocalHttp() {
  WiFiClient client = server.available();
  if (!client) return;

  // Read the request line (e.g. "POST /command HTTP/1.1")
  String reqLine = client.readStringUntil('\n');
  reqLine.trim();
  Serial.print("HTTP Request: ");
  Serial.println(reqLine);

  // Read headers and look for Content-Length (case-insensitive)
  int contentLength = 0;
  unsigned long headerStart = millis();
  while (true) {
    if (!client.connected()) break;
    if (client.available()) {
      String header = client.readStringUntil('\n');
      header.trim();
      if (header.length() == 0) break; // blank line -> end of headers
      Serial.print("Header: ");
      Serial.println(header);

      // Lowercase copy for case-insensitive check
      String headerLower = header;
      headerLower.toLowerCase();
      if (headerLower.startsWith("content-length:")) {
        // Extract the numeric value after the colon
        int idx = header.indexOf(':');
        if (idx != -1) {
          contentLength = header.substring(idx + 1).toInt();
        }
      }
    } else {
      // safety timeout for headers
      if (millis() - headerStart > 1000) break;
    }
  }

  // GET /ping -> simple health check
  if (reqLine.startsWith("GET /ping")) {
    String body = "{\"ok\":true}";
    client.print("HTTP/1.1 200 OK\r\n");
    client.print("Content-Type: application/json\r\n");
    client.print("Content-Length: ");
    client.print(body.length());
    client.print("\r\nAccess-Control-Allow-Origin: *\r\n\r\n");
    client.print(body);
    client.stop();
    return;
  }

  // GET /toggle?pin=...&state=... -> quick manual toggle endpoint for testing
  if (reqLine.startsWith("GET /toggle")) {
    int pPin = reqLine.indexOf("pin=");
    int pState = reqLine.indexOf("state=");
    if (pPin != -1 && pState != -1) {
      int amp = reqLine.indexOf('&', pPin);
      String pinStr = (amp == -1) ? reqLine.substring(pPin + 4) : reqLine.substring(pPin + 4, amp);
      int pin = pinStr.toInt();
      int state = reqLine.substring(pState + 6).toInt();
      digitalWrite(pin, state ? HIGH : LOW);
      String body = "{\"ok\":true}";
      client.print("HTTP/1.1 200 OK\r\nContent-Type: application/json\r\nContent-Length: ");
      client.print(body.length());
      client.print("\r\nAccess-Control-Allow-Origin: *\r\n\r\n");
      client.print(body);
      client.stop();
      return;
    }
  }

  // POST /command -> read body (either using Content-Length or fallback to a short timeout)
  if (reqLine.startsWith("POST /command")) {
    String body = "";
    unsigned long start = millis();

    // If Content-Length was provided, read exactly that many bytes (with a timeout)
    if (contentLength > 0) {
      int toRead = contentLength;
      while (toRead > 0 && (millis() - start) < 2000) {
        if (client.available()) {
          body += (char)client.read();
          toRead--;
        }
      }
    } else {
      // Fallback: read until no data arrives for 200ms (useful for some clients)
      unsigned long lastAvail = millis();
      while ((millis() - lastAvail) < 200 && (millis() - start) < 2000) {
        if (client.available()) {
          body += (char)client.read();
          lastAvail = millis();
        }
      }
    }

    Serial.print("Local Body: ");
    Serial.println(body);

    // Parse JSON (naive but tolerant for the small, known payload shape)
    String room = extractJsonString(body, "room");
    String action = extractJsonString(body, "action");
    int timerSeconds = extractJsonInt(body, "timer");

    // Validate parsed values
    if (room.length() == 0 || action.length() == 0) {
      Serial.println("Invalid command: missing room or action");
      String respErr = "{\"ok\":false,\"error\":\"missing room or action\"}";
      client.print("HTTP/1.1 400 Bad Request\r\n");
      client.print("Content-Type: application/json\r\n");
      client.print("Content-Length: ");
      client.print(respErr.length());
      client.print("\r\nAccess-Control-Allow-Origin: *\r\n\r\n");
      client.print(respErr);
      client.stop();
      return;
    }

    // Convert the local HTTP command into the cloudCommand format and set it.
    // This keeps cloud and local flows consistent: cloudCommand = "room:action:timer"
    String cmd = room + ":" + action + ":" + String(timerSeconds);
    cloudCommand = cmd;
    Serial.print("Set cloudCommand from local HTTP: ");
    Serial.println(cloudCommand);

    // Respond OK to the HTTP client
    String resp = "{\"ok\":true}";
    client.print("HTTP/1.1 200 OK\r\n");
    client.print("Content-Type: application/json\r\n");
    client.print("Content-Length: ");
    client.print(resp.length());
    client.print("\r\nAccess-Control-Allow-Origin: *\r\n\r\n");
    client.print(resp);
    client.stop();
    return;
  }

  // Default: 404 Not Found
  client.print("HTTP/1.1 404 Not Found\r\nContent-Length:0\r\n\r\n");
  client.stop();
}

// Small JSON helpers (naive but tolerant)
// - extractJsonString: finds "key":"value" and returns value (or empty string)
// - extractJsonInt: finds "key": <number> and returns integer (or 0)
// These are intentionally simple and work for the small, predictable payloads used here.
String extractJsonString(const String &body, const String &key) {
  String pattern = "\"" + key + "\"";
  int p = body.indexOf(pattern);
  if (p == -1) return "";
  int colon = body.indexOf(':', p + pattern.length());
  if (colon == -1) return "";
  int quote1 = body.indexOf('"', colon);
  if (quote1 == -1) return "";
  int quote2 = body.indexOf('"', quote1 + 1);
  if (quote2 == -1) return "";
  return body.substring(quote1 + 1, quote2);
}

int extractJsonInt(const String &body, const String &key) {
  String pattern = "\"" + key + "\"";
  int p = body.indexOf(pattern);
  if (p == -1) return 0;
  int colon = body.indexOf(':', p + pattern.length());
  if (colon == -1) return 0;
  int start = colon + 1;
  while (start < body.length() && (body[start] == ' ' || body[start] == '\t')) start++;
  int end = start;
  while (end < body.length() && (isDigit(body[end]) || body[end] == '-')) end++;
  if (end == start) return 0;
  return body.substring(start, end).toInt();
}